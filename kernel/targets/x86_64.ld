ENTRY(entry)
OUTPUT_FORMAT(elf64-x86-64)

SECTIONS 
{
    . = 0xffffffff80000000;

    .text : ALIGN(4K)
    {
        *(.text)
    }

    .rodata : ALIGN(4K)
    {
        *(.rodata)
    }

    .data : ALIGN(4K)
    {
        *(.data)
    }

    .bss : ALIGN(4K)
    {
        *(.bss)
    }
}